&spi0 {
    status = "okay";
    pinctrl-names = "default";
    pinctrl-0 = <&spi0m2_cs0 &spi0m2_pins>;
    max-freq = <2000000>;

    morse_wifi: morse_wifi@0 {
        compatible = "morse,mm610x-spi";
        reg = <0>;
        spi-max-frequency = <2000000>;
        reset-gpios = <&gpio1 8 0>;
        power-gpios = <&gpio1 7 0>, <&gpio1 4 0>;
        spi-irq-gpios = <&gpio3 17 0>;
        status = "okay";
    };
};