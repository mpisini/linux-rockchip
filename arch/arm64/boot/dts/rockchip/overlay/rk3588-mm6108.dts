/dts-v1/;
/plugin/;

/ {
    fragment@0 {
        target = <&spi0>;

        __overlay__ {
            status = "okay";
            #address-cells = <1>;
            #size-cells = <0>;
            pinctrl-names = "default";
            pinctrl-0 = <&spi0m2_cs0 &spi0m2_pins>;
            max-freq = <2000000>;  // Max supported bus frequency (controller limit)

            morse_wifi@0 {
                compatible = "morse,mm610x-spi";
                reg = <0>;                    // Chip Select 0
                spi-max-frequency = <2000000>; // Morse Wi-Fi device max freq = 31.25 MHz
                reset-gpios = <&gpio1 8 0>;
                power-gpios = <&gpio1 7 0>, <&gpio1 4 0>;
                spi-irq-gpios = <&gpio3 17 0>;
                status = "okay";
            };
        };
    };
};